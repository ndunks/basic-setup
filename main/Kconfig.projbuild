## main/Kconfig.projbuild
```kconfig
menu "App Configuration"

    config APP_WIFI_MAX_CLIENT
        int "AP mode maximum client allowed to connect"
        default 5
        help
            Set the Maximum retry to avoid station reconnecting to the AP unlimited when the AP is really inexistent.

    config APP_WIFI_MAX_RETRY
        int "STA mode connect maximum retry"
        default 5
        help
            Set the Maximum retry to avoid station reconnecting to the AP unlimited when the AP is really inexistent.
    
    config APP_WIFI_ACTION_TIMEOUT
        int "Wifi Action Timeout"
        default 10000
        help
            Default timeout on Wifi operation

    config APP_WITH_SENSOR
        bool "With Sensor"
        default y
        help
            Include sensor functions

    config APP_WITH_COMMANDS
        bool "With Serial Terminal"
        default y
        help
            Include terminal functions via UART
    choice 
        prompt "Board Type"
        config APP_NODEMCU_SUPPORT
            bool "NodeMCU"
            default y
            help
                For NodeMCU/Wemos D1 Mini
        config APP_ESP01_SUPPORT
            bool "ESP-01"
            default n
            help
                For AI Thinker ESP-01
    endchoice
    choice 
        prompt "ESP-01 Actuators"
        depends on APP_ESP01_SUPPORT
        config APP_ESP01_SUPPORT_SHIFTREG
            bool "With Shift-Register"
            default y
            help
                For ESP-01 Shift-Register (8 Actuator only)
        config APP_ESP01_SUPPORT_PLAIN
            bool "Without Shift-Register"
            default n
            help
                For ESP-01 with only Direct GPIO, no tx, rx (4 Actuator only)
        config APP_ESP01_SUPPORT_LC
            bool "Serial with LC-ESP01-4R-12V"
            default n
            help
                LC Technology 12V 4 Channel Relay Board (LC-ESP01-4R-12V). https://templates.blakadder.com/LC-ESP01-4R-12V.html
    endchoice
    choice 
        prompt "NodeMCU Actuators"
        depends on APP_NODEMCU_SUPPORT
        config APP_ESP01_SUPPORT_SHIFTREG
            bool "With Shift-Register"
            default y
            help
                For NodeMCU Shift-Register (8 Actuator only)
    endchoice

endmenu
```
